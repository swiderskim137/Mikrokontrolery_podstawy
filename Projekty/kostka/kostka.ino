#include <SPI.h>
#include <Wire.h>
#include <Adafruit_GFX.h>
#include <Adafruit_SSD1306.h>

#define SCREEN_WIDTH 128 // OLED display width, in pixels
#define SCREEN_HEIGHT 64 // OLED display height, in pixels
#define OLED_RESET     4 // Reset pin # (or -1 if sharing Arduino reset pin)
Adafruit_SSD1306 display(SCREEN_WIDTH, SCREEN_HEIGHT, &Wire, OLED_RESET);
//Adafruit_SSD1306 display(1, 1, &Wire, OLED_RESET);
#define LOGO_HEIGHT   64
#define LOGO_WIDTH    128
static const unsigned char PROGMEM logo_cat[] =
{ 0x00, 0x00, 0x00, 0x00, 0x00, 0x00, 0x00, 0x00, 0x00, 0x00, 0x00, 0x00, 0x00, 0x00, 0x00, 0x00,
  0x00, 0x00, 0x00, 0x00, 0x00, 0x00, 0x00, 0x00, 0x00, 0x00, 0x00, 0x00, 0x00, 0x00, 0x00, 0x00,
  0x00, 0x00, 0x00, 0x00, 0x00, 0x00, 0x00, 0x00, 0x00, 0x00, 0x00, 0x00, 0x00, 0x00, 0x00, 0x00,
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  0x00, 0x00, 0x00, 0x00, 0x00, 0x00, 0x00, 0x00, 0x00, 0x00, 0x00, 0x00, 0x00, 0x00, 0x00, 0x00
};

int s = 1;
int zr = 4;
int mod_atak = 5;
int at_luk = 1; //atut skupienie na broni
int at_sz_strz = -2; //atut szybki strzał

int mod_luk = mod_atak + zr + at_luk;
int mod_luk2 = mod_atak + zr + at_luk + at_sz_strz;
int mod_rapier = mod_atak + zr;
int mod_sztylet = mod_atak + zr;

const int buttonRuch = 15;
const int buttonWybor = 10;
const int ledPin =  13;
int buttonState = 0;

int wynik, x, wyb = 0, sum, sum2, sum3, sum4;
float sr = 0;

void setup() {
  Serial.begin(9600);

  pinMode(ledPin, OUTPUT);
  pinMode(buttonRuch, INPUT);
  pinMode(buttonWybor, INPUT);

  display.begin(SSD1306_SWITCHCAPVCC, 0x3C);
  display.clearDisplay();
  //display.drawPixel(10, 10, SSD1306_WHITE);
  //display.display();
  //delay(500);
  testdrawbitmap();
  display.invertDisplay(true);
  delay(100);
  display.invertDisplay(false);
  delay(100);
  display.clearDisplay();
  //delay(1000);

  display.setTextColor(SSD1306_WHITE);        // Draw white text
  display.setCursor(0, 10);            // Start at top-left corner
  display.setTextSize(2);             // Normal 1:1 pixel scale
  display.println(F("KOSTKA\n"));
  display.display();
  delay(100);
  menu();
}

void loop() {
  buttonState = digitalRead(buttonRuch);
  if (digitalRead(buttonWybor))
  {
    wyb++;
    if (wyb > 4) {
      wyb = 0;
    }
    menu();
    digitalWrite(ledPin, HIGH);
    delay(200);
    digitalWrite(ledPin, LOW);
  }

  if (buttonState == HIGH) {
    switch (wyb) {
      case 0:
        K20();
        break;
      case 1:
        bron(8, mod_luk, 0); //luk
        break;
      case 2:
        luk2(8, mod_luk2, 0);
        break;
      case 3:
        bron(6, mod_rapier, 0); //rapier();
        break;
      case 4:
        bron(4, mod_sztylet, 0); //sztylet();
        break;
    }
  }
}

void menu() {
  display.clearDisplay();
  display.setTextSize(1);
  display.setCursor(10, 0);
  display.println(F("K20"));
  display.setCursor(10, 10);
  display.println(F("Luk"));
  display.setCursor(10, 20);
  display.println(F("Luk 2x"));
  display.setCursor(10, 30);
  display.println(F("Rapier"));
  display.setCursor(10, 40);
  display.println(F("Sztylet"));
  display.setCursor(0, wyb * 10);
  display.println(F("+"));

  display.display();
}


void bron(int K, int mod, int mod_obr) {
  display.setTextSize(2);
  for (int i = 0; i < 10; i++) {
    display.clearDisplay();
    display.setCursor(10, 10);
    display.print(F("K20 K"));
    display.print(K);
    display.setCursor(10, 28);
    display.print(losowanie(20));
    display.setCursor(58, 28);
    display.print(losowanie(K));
    display.display();
    delay(i * 20);
  }
  delay(200);
  display.clearDisplay();
  display.setCursor(10, 10);
  display.print(F("K20 K"));
  display.print(K);
  display.setCursor(10, 28);
  sum = losowaniex();
  display.print(sum);
  display.setCursor(10, 44);
  display.print(sum + mod);
  display.setCursor(58, 28);
  sum2 = losowanie(K);
  display.print(sum2 + mod_obr);
  display.display();
  delay(1000);
}

void luk2(int K, int mod, int mod_obr) {
  display.setTextSize(1);
  for (int i = 0; i < 10; i++) {
    display.clearDisplay();
    display.setCursor(10, 10);
    display.println(F("K20 K8 || K20 K8\n"));
    display.setCursor(10, 20);
    display.print(losowanie(20));
    display.setCursor(34, 20);
    display.print(losowanie(K));
    display.setCursor(70, 20);
    display.print(losowanie(20));
    display.setCursor(94, 20);
    display.print(losowanie(K));
    display.display();
    delay(i * 20);
  }
  delay(200);
  display.clearDisplay();
  display.setCursor(10, 10);
  display.println(F("K20 K8 || K20 K8\n"));

  display.setCursor(10, 20);
  sum = losowaniex();
  display.print(sum);
  display.setCursor(10, 30);
  display.print(sum + mod);
  display.setCursor(34, 30);
  sum2 = losowanie(K);
  display.print(sum2);

  display.setCursor(70, 20);
  sum3 = losowaniex();
  display.print(sum3);
  display.setCursor(70, 30);
  display.print(sum3 + mod);
  display.setCursor(94, 30);
  sum4 = losowanie(K);
  display.print(sum4);
  display.display();
  delay(1000);
}

void K20() {
  display.setTextSize(2);
  for (int i = 0; i < 10; i++) {
    display.clearDisplay();
    display.setCursor(10, 10);
    display.println(F("K20\n"));
    display.setCursor(10, 28);
    display.print(losowanie(20));
    display.display();
    delay(i * 20);
  }
  delay(200);
  display.clearDisplay();
  display.setCursor(10, 10);
  display.println(F("K20\n"));
  display.setCursor(10, 28);
  display.println(losowaniex());
  display.display();
  delay(1000);
}

long losowanie(int k) {
  randomSeed(millis());
  wynik = random(1, k + 1);
  return wynik;
}
long losowaniex() {
  randomSeed(millis());
  wynik = random(1, 21);
  if (wynik == 1) {
    x = random(1, 21);
    if (x > 10) {
      wynik = x;
    }
  }
  return wynik;
}

void testdrawbitmap(void) {
  display.clearDisplay();
  display.drawBitmap(
    (display.width()  - LOGO_WIDTH ) / 2,
    (display.height() - LOGO_HEIGHT) / 2,
    logo_cat, LOGO_WIDTH, LOGO_HEIGHT, 1);
  display.display();
  delay(1000);
}
